## boards/shields/display_adapter/Kconfig.shield
```kconfig
config SHIELD_DISPLAY_ADAPTER
    def_bool $(shields_list_contains,display_adapter)
```

## boards/shields/key5/Kconfig.defconfig
```kconfig
if SHIELD_KEY5_DONGLE

config ZMK_KEYBOARD_NAME
	default "key5"
	
config ZMK_SPLIT_ROLE_CENTRAL
	default y

endif


if SHIELD_KEY5_DONGLE || SHIELD_KEY5_MAIN
    
config ZMK_SPLIT
    default y

config ZMK_POINTING
    default y
    
config ZMK_SLEEP
    default y

endif
```

## boards/shields/key5/Kconfig.shield
```kconfig
config SHIELD_KEY5_DONGLE
	def_bool $(shields_list_contains,key5_dongle)

config SHIELD_KEY5_MAIN
	def_bool $(shields_list_contains,key5_main)
```

## boards/shields/key66/Kconfig.defconfig
```kconfig
if SHIELD_KEY66_DONGLE

config ZMK_KEYBOARD_NAME
	default "key66"
	
config ZMK_SPLIT_ROLE_CENTRAL
	default y

config ZMK_USB
    default y
	
endif


if SHIELD_KEY66_DONGLE || SHIELD_KEY66_MAIN
    
config ZMK_SPLIT
    default y

config ZMK_POINTING
    default y
    
config ZMK_SLEEP
    default y

endif
```

## boards/shields/key66/Kconfig.shield
```kconfig
config SHIELD_KEY66_DONGLE
	def_bool $(shields_list_contains,key66_dongle)

config SHIELD_KEY66_MAIN
	def_bool $(shields_list_contains,key66_main)
```

## boards/shields/keyb/Kconfig.defconfig
```kconfig
if SHIELD_KEYB_DONGLE

config ZMK_KEYBOARD_NAME
	default "keyb"
	
config ZMK_SPLIT_ROLE_CENTRAL
	default y

endif #SHIELD_KEYB_DONGLE


if SHIELD_KEYB_DONGLE || SHIELD_KEYB_MAIN
    
config ZMK_SPLIT
    default y

config ZMK_POINTING
    default y
    
config ZMK_SLEEP
    default y

endif
```

## boards/shields/keyb/Kconfig.shield
```kconfig
config SHIELD_KEYB_DONGLE
	def_bool $(shields_list_contains,keyb_dongle)

config SHIELD_KEYB_MAIN
	def_bool $(shields_list_contains,keyb_main)
```

## config/boards/shields/display_adapter/Kconfig.defconfig
```kconfig
if SHIELD_DISPLAY_ADAPTER

choice ZMK_DISPLAY_STATUS_SCREEN
    default ZMK_DISPLAY_STATUS_SCREEN_CUSTOM
endchoice

config ZMK_DISPLAY_STATUS_SCREEN_CUSTOM
    select LV_USE_LABEL

choice ZMK_DISPLAY_WORK_QUEUE
    default ZMK_DISPLAY_WORK_QUEUE_DEDICATED
endchoice

config LV_Z_MEM_POOL_SIZE
    default 8192

config LV_Z_VDB_SIZE
    default 64

config LV_DPI_DEF
    default 148

config LV_Z_BITS_PER_PIXEL
    default 1

choice LV_COLOR_DEPTH
    default LV_COLOR_DEPTH_1
endchoice

endif
```

## config/boards/shields/keyb/Kconfig.defconfig
```kconfig
if SHIELD_KEYB_DONGLE

config ZMK_KEYBOARD_NAME
	default "keyb"
	
config ZMK_SPLIT_ROLE_CENTRAL
	default y
	
config ZMK_SPLIT_BLE_CENTRAL_PERIPHERALS
    default 1

config ZMK_SPLIT_BLE_CENTRAL_BATTERY_LEVEL_FETCHING
    default y

config ZMK_SPLIT_BLE_CENTRAL_BATTERY_LEVEL_PROXY
    default y

config ZMK_USB
    default y

endif

    
if SHIELD_KEYB_DONGLE || SHIELD_KEYB_MAIN
    
config ZMK_SPLIT
    default y

config ZMK_POINTING
    default y
    
config ZMK_SLEEP
    default y
    
endif
```

## config/boards/shields/keyb/Kconfig.shield
```kconfig
config SHIELD_KEYB_MAIN
	def_bool $(shields_list_contains,keyb)

config SHIELD_KEYB_DONGLE
	def_bool $(shields_list_contains,keyb_dongle)
```

## config/boards/shields/mate/Kconfig.defconfig
```kconfig
if SHIELD_MATE_DONGLE

config ZMK_KEYBOARD_NAME
	default "mate"
	
config ZMK_SPLIT_ROLE_CENTRAL
	default y
	
endif

if SHIELD_MATE_LEFT || SHIELD_MATE_RIGHT || SHIELD_MATE_DONGLE 

config ZMK_SPLIT
	default y
	
endif
```

## config/boards/shields/mate/Kconfig.shield
```kconfig
config SHIELD_MATE_LEFT
	def_bool $(shields_list_contains,mate_left)

config SHIELD_MATE_RIGHT
	def_bool $(shields_list_contains,mate_right)

config SHIELD_MATE_DONGLE
	def_bool $(shields_list_contains,mate_dongle)
```
