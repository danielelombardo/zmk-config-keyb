#include "mate.dtsi"

// dummy pin for dongle
&kscan0 {
    row-gpios
        = <&pro_micro 9 (GPIO_ACTIVE_HIGH | GPIO_PULL_DOWN)>
    ;
    col-gpios
        = <&pro_micro 10 GPIO_ACTIVE_HIGH>
    ;
};
